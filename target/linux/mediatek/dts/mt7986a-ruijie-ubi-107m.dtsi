// SPDX-License-Identifier: (GPL-2.0 OR MIT)

&spi0 {
	flash@0 {
		mediatek,nmbm;
		mediatek,bmt-max-ratio = <1>;
		mediatek,bmt-max-reserved-blocks = <64>;

		partitions {
			partition@680000 {
				label = "ubi";
				reg = <0x680000 0x6b00000>;
			};
		};
	};
};
