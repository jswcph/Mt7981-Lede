// SPDX-License-Identifier: GPL-2.0-or-later OR MIT

/dts-v1/;
#include "mt7986a-ruijie-rg-x60-pro.dtsi"

/ {
	compatible = "ruijie,rg-x60-pro", "mediatek,mt7986a";
	model = "Ruijie RG-X60 Pro (107m)";
};

&partitions {
	partition@680000 {
		label = "ubi";
		reg = <0x680000 0x6b00000>;
	};
};